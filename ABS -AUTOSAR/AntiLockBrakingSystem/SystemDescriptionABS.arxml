AUTOSAR XML (schema 00050)
package /ARRoot
  can cluster BrakeBackLeftCanCluster
  ecu instance BrakeBackLeftEcuInstance: can-communication-connector=/ARRoot/BrakeBackLeftEcuInstance/
  system BrakeBackLeftSystem: root-software-compositions=root-sw-composition-prototype={flat-map=WheelFlatMap, software-composition=BrakeBackLeftTopLevelComposition}
  composition sw component type BrakeBackLeftTopLevelComposition: components=sw-component-prototype=type=BrakeBackLeftTopLevelComposition
    delegation sw connector BrakeBackRightConnectorProto
  can cluster BrakeBackRightCanCluster
  ecu instance BrakeBackRightEcuInstance: can-communication-connector=/ARRoot/BrakeBackRightEcuInstance/
  system BrakeBackRightSystem: root-software-compositions=root-sw-composition-prototype={flat-map=WheelFlatMap, software-composition=BrakeBackRightTopLevelComposition}
  composition sw component type BrakeBackRightTopLevelComposition: components=sw-component-prototype=type=BrakeBackRightTopLevelComposition
    delegation sw connector BrakeBackLeftConnectorProto
  flat map BrakeFlatMap: instances=flat-instance-descriptor=CoilLeftSystem.HeatingElementLeft
  can cluster BrakeFrontLeftCanCluster
  ecu instance BrakeFrontLeftEcuInstance: can-communication-connector=/ARRoot/BrakeFrontLeftEcuInstance/
  system BrakeFrontLeftSystem: root-software-compositions=root-sw-composition-prototype={flat-map=WheelFlatMap, software-composition=BrakeFrontLeftTopLevelComposition}
  composition sw component type BrakeFrontLeftTopLevelComposition: components=sw-component-prototype=type=BrakeFrontLeftTopLevelComposition
    delegation sw connector BrakeFrontLeftConnectorProto
  can cluster BrakeFrontRightCanCluster
  ecu instance BrakeFrontRightEcuInstance: can-communication-connector=/ARRoot/BrakeFrontRightEcuInstance/
  system BrakeFrontRightSystem: root-software-compositions=root-sw-composition-prototype={flat-map=WheelFlatMap, software-composition=BrakeFrontRightTopLevelComposition}
  composition sw component type BrakeFrontRightTopLevelComposition: components=sw-component-prototype=type=BrakeFrontRightTopLevelComposition
    delegation sw connector BrakeFrontRightConnectorProto
  flat map DisplayLedLeftFlatMap: instances=flat-instance-descriptor=LedDialLeftSystem.DialLedLeft
  ecu instance LedDisplayEcuInstance
    can communication controller LedDisplayCanCommunicationController
    can communication connector LedDisplayCanCommunicationConnector: comm-controller=LedDisplayCanCommunicationController
  system LedDisplaySystem
    system mapping LedDisplaySystemMapping
      data-mappings:
        client-server-to-signal-mapping=communication-direction=OUT
        sender-receiver-to-signal-mapping=communication-direction=OUT
        sender-receiver-to-signal-mapping=communication-direction=IN
      sw-impl-mappings:
        swc to impl mapping LedDisplaySwcToImpMapping: component=LedDisplayRootSoftwareComposition.LedDialLeftSwComponentProto.
      sw-mappings:
        swc to ecu mapping LedDisplaySwToEcuMapping: component=LedDisplayRootSoftwareComposition.LedDialLeftSwComponentProto., controlled-hw-element=/ARRoot/, ecu-instance=LedDisplayEcuInstance, processing-unit=/ARRoot/
    root-software-compositions:
      root sw composition prototype LedDisplayRootSoftwareComposition
  composition sw component type LedDisplayTopLevelComposition: components=sw-component-prototype=type=LedDisplayTopLevelComposition
  can cluster WheelBackLeftCanCluster
  ecu instance WheelBackLeftEcuInstance: can-communication-connector=/ARRoot/WheelBackLeftEcuInstance/
  system WheelBackLeftSystem: root-software-compositions=root-sw-composition-prototype={flat-map=WheelFlatMap, software-composition=WheelFrontLeftTopLevelComposition}
  composition sw component type WheelBackLeftTopLevelComposition: components=sw-component-prototype=type=WheelBackLeftTopLevelComposition
    delegation sw connector WheelBackLeftConnectorProto
  can cluster WheelBackRightCanCluster
  ecu instance WheelBackRightEcuInstance: can-communication-connector=/ARRoot/WheelBackRightEcuInstance/
  system WheelBackRightSystem: root-software-compositions=root-sw-composition-prototype={flat-map=WheelFlatMap, software-composition=WheelBackRightTopLevelComposition}
  composition sw component type WheelBackRightTopLevelComposition: components=sw-component-prototype=type=WheelBackRightTopLevelComposition
    delegation sw connector WheelBackRightConnectorProto
  flat map WheelFlatMap: instances=flat-instance-descriptor=CoilLeftSystem.HeatingElementLeft
  can cluster WheelFrontLeftCanCluster
  can cluster WheelFrontLeftCanCluster
  ecu instance WheelFrontLeftEcuInstance: can-communication-connector=/ARRoot/WheelFrontLeftEcuInstance/
  system WheelFrontLeftSystem: root-software-compositions=root-sw-composition-prototype={flat-map=WheelFlatMap, software-composition=WheelFrontLeftTopLevelComposition}
  composition sw component type WheelFrontLeftTopLevelComposition: components=sw-component-prototype=type=WheelFrontLeftTopLevelComposition
    delegation sw connector WheelFrontLeftConnectorProto
  ecu instance WheelFrontRightEcuInstance: can-communication-connector=/ARRoot/WheelFrontRightEcuInstance/
  system WheelFrontRightSystem: root-software-compositions=root-sw-composition-prototype={flat-map=WheelFlatMap, software-composition=WheelFrontRightTopLevelComposition}
  composition sw component type WheelFrontRightTopLevelComposition: components=sw-component-prototype=type=WheelFrontRightTopLevelComposition
    delegation sw connector WheelFrontRightConnectorProto
